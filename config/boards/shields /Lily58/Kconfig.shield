## config/boards/shields /Lily58/Kconfig.shield
```kconfig
# No whitespace after the comma or in the keyboard name!
config SHIELD_lily58_left
	def_bool $(shields_list_contains,Lily58_left)

config SHIELD_lily58_right
	def_bool $(shields_list_contains,Lily58_right)

config SHIELD_lily58_dongle
	def_bool $(shields_list_contains,Lily58_dongle)
```
